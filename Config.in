## Config.in
```kconfig
source "$BR2_EXTERNAL_XGO2_BUILDROOT_PATH/package/python-xgo-pythonlib/Config.in"
```

## configs/xgo2_defconfig
```kconfig
BR2_aarch64=y
BR2_cortex_a72=y
BR2_ARM_FPU_VFPV4=y
BR2_PACKAGE_HOST_LINUX_HEADERS_CUSTOM_6_1=y
BR2_TOOLCHAIN_BUILDROOT_CXX=y
BR2_TARGET_GENERIC_HOSTNAME="XGO2"
BR2_TARGET_GENERIC_ISSUE="Welcome to the XGO2 - your robotdog!"
BR2_INIT_SYSTEMD=y
BR2_TARGET_GENERIC_ROOT_PASSWD="xgo2"
BR2_SYSTEM_DEFAULT_PATH="/bin:/sbin:/usr/bin:/usr/sbin"
BR2_ROOTFS_OVERLAY="$(BR2_EXTERNAL_XGO2_BUILDROOT_PATH)/overlay"
BR2_ROOTFS_POST_BUILD_SCRIPT="$(BR2_EXTERNAL_XGO2_BUILDROOT_PATH)/post-build.sh"
BR2_ROOTFS_POST_IMAGE_SCRIPT="board/raspberrypicm4io-64/post-image.sh"
BR2_LINUX_KERNEL=y
BR2_LINUX_KERNEL_CUSTOM_GIT=y
BR2_LINUX_KERNEL_CUSTOM_REPO_URL="https://github.com/raspberrypi/linux.git"
BR2_LINUX_KERNEL_CUSTOM_REPO_VERSION="rpi-6.1.y"
BR2_LINUX_KERNEL_USE_CUSTOM_CONFIG=y
BR2_LINUX_KERNEL_CUSTOM_CONFIG_FILE="$(BR2_EXTERNAL_XGO2_BUILDROOT_PATH)/linux.config"
BR2_LINUX_KERNEL_DTS_SUPPORT=y
BR2_LINUX_KERNEL_CUSTOM_DTS_PATH="$(BR2_EXTERNAL_XGO2_BUILDROOT_PATH)/bcm2711-rpi-cm4.dts"
BR2_LINUX_KERNEL_NEEDS_HOST_OPENSSL=y
BR2_PACKAGE_BUSYBOX_CONFIG="$(BR2_EXTERNAL_XGO2_BUILDROOT_PATH)/busybox.config"
BR2_PACKAGE_ALSA_UTILS=y
BR2_PACKAGE_ALSA_UTILS_APLAY=y
BR2_PACKAGE_BRCMFMAC_SDIO_FIRMWARE_RPI=y
BR2_PACKAGE_BRCMFMAC_SDIO_FIRMWARE_RPI_BT=y
BR2_PACKAGE_BRCMFMAC_SDIO_FIRMWARE_RPI_WIFI=y
BR2_PACKAGE_RPI_FIRMWARE=y
BR2_PACKAGE_RPI_FIRMWARE_VARIANT_PI4=y
BR2_PACKAGE_RPI_FIRMWARE_VARIANT_PI4_X=y
BR2_PACKAGE_RPI_FIRMWARE_CONFIG_FILE="$(BR2_EXTERNAL_XGO2_BUILDROOT_PATH)/config.txt"
BR2_PACKAGE_RPI_FIRMWARE_CMDLINE_FILE="$(BR2_EXTERNAL_XGO2_BUILDROOT_PATH)/cmdline.txt"
BR2_PACKAGE_PYTHON3_PY_PYC=y
BR2_PACKAGE_PYTHON_IPYTHON=y
BR2_PACKAGE_BLUEZ5_UTILS=y
BR2_PACKAGE_BLUEZ5_UTILS_CLIENT=y
BR2_PACKAGE_BLUEZ5_UTILS_TOOLS=y
# BR2_PACKAGE_BLUEZ5_UTILS_PLUGINS_NETWORK is not set
BR2_PACKAGE_BRCM_PATCHRAM_PLUS=y
BR2_PACKAGE_CRDA=y
BR2_PACKAGE_OPENSSH=y
# BR2_PACKAGE_OPENSSH_CLIENT is not set
# BR2_PACKAGE_OPENSSH_SANDBOX is not set
BR2_PACKAGE_WPA_SUPPLICANT=y
BR2_PACKAGE_WPA_SUPPLICANT_DEBUG_SYSLOG=y
BR2_PACKAGE_WPA_SUPPLICANT_CLI=y
BR2_PACKAGE_WPA_SUPPLICANT_DBUS=y
BR2_PACKAGE_WPA_SUPPLICANT_DBUS_INTROSPECTION=y
BR2_PACKAGE_SYSTEMD_LOGIND=y
BR2_PACKAGE_UTIL_LINUX_LOGIN=y
BR2_TARGET_ROOTFS_EXT2=y
BR2_TARGET_ROOTFS_EXT2_4=y
BR2_TARGET_ROOTFS_EXT2_SIZE="250M"
# BR2_TARGET_ROOTFS_TAR is not set
BR2_PACKAGE_HOST_DOSFSTOOLS=y
BR2_PACKAGE_HOST_GENIMAGE=y
BR2_PACKAGE_HOST_MTOOLS=y
BR2_PACKAGE_HOST_RASPBERRYPI_USBBOOT=y
BR2_PACKAGE_PYTHON_XGO_PYTHONLIB=y
```

## package/python-xgo-pythonlib/Config.in
```kconfig
config BR2_PACKAGE_PYTHON_XGO_PYTHONLIB
	bool "python-xgo-pythonlib"
	select BR2_PACKAGE_FREETYPE
	select BR2_PACKAGE_OPENCV3
	select BR2_PACKAGE_OPENCV3_LIB_PYTHON
	select BR2_PACKAGE_OPENCV3_WITH_JPEG
	select BR2_PACKAGE_PYTHON3
	select BR2_PACKAGE_PYTHON3_SSL
	select BR2_PACKAGE_PYTHON_PILLOW
	select BR2_PACKAGE_PYTHON_RPI_GPIO
	select BR2_PACKAGE_PYTHON_SERIAL
	select BR2_PACKAGE_PYTHON_SPIDEV
	help
	  PythonLib for XGO2-DOG.

	  https://github.com/Xgorobot/XGO-PythonLib
```
